#include p16f84a.inc             


ODD                 EQU B'10101010'
EVEN 		EQU B'01010101'	
OFF 		EQU B'00000000'
ON		EQU B'11111111'
COUNT1 	EQU 0X31 
COUNT2 	EQU 0X32 


ORG 0X0000
GOTO START
ORG 0X0004


START 

BSF		 STATUS,RP0
MOVLW 		B'11110000' 
MOVWF 		TRISA
MOVLW 		B'0000000' 
MOVWF 		TRISB
BCF		 STATUS,RP0; 


S1 
BTFSS PORTA,3
MOVLW ODD

BTFSC PORTA,3
MOVLW EVEN

MOVWF PORTB
CALL DEL_p5sec
MOVLW OFF
MOVWF PORTB
CALL DEL_p5sec


BTFSS PORTA,4
GOTO S1

GOTO S2


S2
MOVLW ON
MOVWF PORTB
BTFSS PORTA,4
GOTO S1

GOTO S2

DEL_p5sec

MOVLW 	D'0'
MOVWF 	COUNT1
MOVLW 	D'22'
MOVWF 	COUNT2

LOOP 	NOP
NOP
NOP
NOP
NOP
DECFSZ 		COUNT1 , F
GOTO 	LOOP
DECFSZ 		COUNT2 , F
GOTO	 LOOP 
RETURN
;====================================================================
      END


